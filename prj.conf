## prj.conf
```kconfig
# nothing here
CONFIG_SERIAL=y

# Logging
CONFIG_LOG=y
CONFIG_LOG_OUTPUT=y

# Networking
CONFIG_BT=n
CONFIG_NETWORKING=y
CONFIG_NET_UDP=n
CONFIG_NET_TCP=y
CONFIG_NET_IPV4=n
CONFIG_NET_IPV6=y
CONFIG_NET_SOCKETS=y

# Network Config
CONFIG_NET_CONFIG_SETTINGS=y
CONFIG_NET_CONFIG_AUTO_INIT=y
CONFIG_NET_CONFIG_NEED_IPV6=y
CONFIG_NET_CONFIG_MY_IPV6_ADDR="2001:db8::1"
CONFIG_NET_CONFIG_PEER_IPV6_ADDR="2001:db8::2"
CONFIG_NET_CONFIG_NEED_IPV4=n
CONFIG_NET_CONFIG_MY_IPV4_ADDR=""
CONFIG_NET_CONFIG_PEER_IPV4_ADDR=""

CONFIG_NET_L2_IEEE802154=y
CONFIG_NET_CONFIG_IEEE802154_CHANNEL=1
CONFIG_MAIN_STACK_SIZE=2048
CONFIG_NET_L2_IEEE802154_FRAGMENT_REASS_CACHE_SIZE=32
CONFIG_IEEE802154_CC13XX_CC26XX_SUB_GHZ_NUM_RX_BUF=6

CONFIG_NET_PKT_RX_COUNT=64
CONFIG_NET_PKT_TX_COUNT=64
CONFIG_NET_BUF_RX_COUNT=64
CONFIG_NET_BUF_TX_COUNT=64
CONFIG_NET_CONTEXT_NET_PKT_POOL=y

CONFIG_SHELL=y
# CONFIG_NET_SHELL=y
# CONFIG_NET_BUF_POOL_USAGE=y
# CONFIG_NET_STATISTICS=y

# CONFIG_TIMING_FUNCTIONS=y
```

## src/main.c
```c
/*
 * Copyright (c) 2012-2014 Wind River Systems, Inc.
 *
 * SPDX-License-Identifier: Apache-2.0
 */

#include <zephyr/logging/log.h>
#include <zephyr/net/socket.h>
#include <zephyr/timing/timing.h>

#define PORT 4242

LOG_MODULE_REGISTER(udp_server, LOG_LEVEL_DBG);

int server_init(const struct sockaddr_in6 *addr6) {
  int sock = zsock_socket(AF_INET6, SOCK_STREAM, IPPROTO_TCP);

  if (sock < 0) {
    LOG_ERR("socket failed: %d", -errno);
    return -1;
  }

  if (zsock_bind(sock, (struct sockaddr *)addr6, sizeof(*addr6)) < 0) {
    LOG_ERR("bind failed: %d", -errno);
    zsock_close(sock);
    return -1;
  }

  if (zsock_listen(sock, 5) < 0) {
    LOG_ERR("listen failed: %d", -errno);
    zsock_close(sock);
    return -1;
  }

  return sock;
}

int main(void) {
  const struct sockaddr_in6 addr6 = {.sin6_family = AF_INET6,
                                     .sin6_port = htons(PORT),
                                     .sin6_addr = in6addr_any};
  int server_sock, conn_sock, ret, buf = 0;

  server_sock = server_init(&addr6);
  if (server_sock < 0) {
    return server_sock;
  }

  LOG_DBG("Waiting for connection");

  conn_sock = zsock_accept(server_sock, NULL, NULL);

  if (conn_sock < 0) {
    LOG_ERR("accept failed: %d", -errno);
    zsock_close(server_sock);
    return -1;
  }

  LOG_INF("TCP server started");

  while (true) {
    ret = zsock_recv(conn_sock, &buf, sizeof(buf), 0);
    if (ret < 0) {
      LOG_ERR("recv failed: %d", -errno);
      return -1;
    }

    zsock_send(conn_sock, &buf, sizeof(buf), 0);
    if (ret < 0) {
      LOG_ERR("send failed: %d", -errno);
      return -1;
    }
  }

  return 0;
}
```
